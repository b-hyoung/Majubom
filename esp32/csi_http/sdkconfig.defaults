## esp32/csi_http/sdkconfig.defaults
```kconfig
#
# Wi-Fi credentials (protocol_examples_common)
#
CONFIG_EXAMPLE_WIFI_SSID="Jvision_Lab"
CONFIG_EXAMPLE_WIFI_PASSWORD="1234567890"

#
# Wi-Fi CSI
#
CONFIG_ESP32_WIFI_CSI_ENABLED=y
CONFIG_ESP32_WIFI_AMPDU_TX_ENABLED=n
CONFIG_ESP32_WIFI_AMPDU_RX_ENABLED=n
CONFIG_ESP32_WIFI_DYNAMIC_RX_BUFFER_NUM=128

#
# UART / monitor
#
CONFIG_ESP_CONSOLE_UART_CUSTOM=y
CONFIG_ESP_CONSOLE_UART=y
CONFIG_ESP_CONSOLE_UART_NUM=0
CONFIG_CONSOLE_UART_BAUDRATE=115200
CONFIG_ESPTOOLPY_MONITOR_BAUD=115200

#
# Performance
#
CONFIG_ESP_TASK_WDT_TIMEOUT_S=30
CONFIG_FREERTOS_HZ=1000
CONFIG_ESP32S3_DEFAULT_CPU_FREQ_240=y
CONFIG_ESP32S3_DEFAULT_CPU_FREQ_MHZ=240

#
# Compiler (ICE 방지: -Os)
#
CONFIG_COMPILER_OPTIMIZATION_SIZE=y
```
